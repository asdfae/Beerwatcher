## buildroot/board/bomill/bbhub/defconfig
```kconfig
BR2_arm=y
BR2_cortex_a15=y
BR2_PACKAGE_HOST_LINUX_HEADERS_CUSTOM_4_19=y
BR2_TOOLCHAIN_BUILDROOT_WCHAR=y
BR2_TOOLCHAIN_BUILDROOT_CXX=y
BR2_TARGET_GENERIC_HOSTNAME="BoMill"
BR2_TARGET_GENERIC_ISSUE="BoMill Hub"
BR2_TARGET_GENERIC_ROOT_PASSWD="systriq"
BR2_ROOTFS_USERS_TABLES="/home/albin/usertable"
BR2_LINUX_KERNEL=y
BR2_LINUX_KERNEL_USE_ARCH_DEFAULT_CONFIG=y
BR2_PACKAGE_LINUX_TOOLS_GPIO=y
BR2_PACKAGE_GIT=y
BR2_PACKAGE_MAKE=y
BR2_PACKAGE_FAN_CTRL=y
BR2_PACKAGE_LM_SENSORS=y
BR2_PACKAGE_LM_SENSORS_FANCONTROL=y
BR2_PACKAGE_LM_SENSORS_PWMCONFIG=y
BR2_PACKAGE_LM_SENSORS_SENSORS_DETECT=y
BR2_PACKAGE_PERL=y
BR2_PACKAGE_LIBSYSFS=y
BR2_PACKAGE_DHCPCD=y
BR2_PACKAGE_OPENSSH=y
BR2_PACKAGE_SUDO=y
BR2_PACKAGE_HTOP=y
BR2_PACKAGE_NANO=y
```
